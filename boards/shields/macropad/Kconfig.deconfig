## boards/shields/macropad/Kconfig.deconfig
```kconfig
# Copyright (c) 2024 Your Name
# SPDX-License-Identifier: MIT

if SHIELD_MACROPAD

config ZMK_KEYBOARD_NAME
    default "Macropad 4K"

endif
```

## boards/shields/macropad/Kconfig.shield
```kconfig
# Copyright (c) 2024 Joshua Wiens
# SPDX-License-Identifier: MIT

config SHIELD_MACROPAD
    def_bool $(shields_list_contains,macropad)
```

## config/Kconfig.deconfig
```kconfig
# Kconfig.defconfig

if SHIELD_MACROPAD

config ZMK_KEYBOARD_NAME
    default "Macropad 4K"

config ZMK_BLE
    default y

endif
```
